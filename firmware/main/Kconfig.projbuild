## firmware/main/Kconfig.projbuild
```kconfig
menu "MiniHSM Configuration"

    menu "WiFi"

        config WIFI_SSID
            string "WiFi SSID"
            default ""
            help
                Nombre de la red WiFi. Si esta vacio el dispositivo
                entra en modo provisioning al primer arranque.

        config WIFI_PASS
            string "WiFi Password"
            default ""
            help
                Contraseña del WiFi.

    endmenu

    menu "ServerHSM"

        config SERVERHSM_URL
            string "URL del serverHSM"
            default "https://api.xami.run"
            help
                URL base del optimizador serverHSM.

        config HEARTBEAT_INTERVAL_SEC
            int "Intervalo de heartbeat (segundos)"
            default 300
            range 30 3600
            help
                Con que frecuencia el miniHSM reporta su IP al serverHSM.

    endmenu

endmenu
```

## firmware/sdkconfig.defaults
```kconfig
# MiniHSM — configuracion por defecto
# Copiar a sdkconfig.local y completar (sdkconfig.local esta en .gitignore)
# O usar: idf.py menuconfig

# WiFi — dejar vacio para modo provisioning
CONFIG_WIFI_SSID=""
CONFIG_WIFI_PASS=""

# ServerHSM
CONFIG_SERVERHSM_URL="https://fileserver.locker/serverHSM/api"
CONFIG_HEARTBEAT_INTERVAL_SEC=300

# ESP32-S3 — Flash 16MB (PSRAM desactivada: no es necesaria y causaba panic en arranque)
CONFIG_ESPTOOLPY_FLASHSIZE_16MB=y

# mbedTLS X.509 write — necesario para cert_manager (cert autofirmado + CSR)
CONFIG_MBEDTLS_X509_CRT_WRITE_C=y
CONFIG_MBEDTLS_X509_CSR_WRITE_C=y
CONFIG_MBEDTLS_PK_WRITE_C=y
CONFIG_MBEDTLS_ENTROPY_C=y
CONFIG_MBEDTLS_HAVE_TIME=y
CONFIG_MBEDTLS_USE_PSA_CRYPTO=y

# Bundle de certificados raiz (para que el heartbeat valide HTTPS de fileserver.locker)
CONFIG_MBEDTLS_CERTIFICATE_BUNDLE=y
CONFIG_MBEDTLS_CERTIFICATE_BUNDLE_DEFAULT_FULL=y
```

## sdkconfig.defaults
```kconfig
# Target
CONFIG_IDF_TARGET="esp32s3"

# Flash
CONFIG_ESPTOOLPY_FLASHSIZE_4MB=y
CONFIG_PARTITION_TABLE_CUSTOM=y
CONFIG_PARTITION_TABLE_CUSTOM_FILENAME="partitions.csv"

# HTTP Server
CONFIG_HTTPD_MAX_REQ_HDR_LEN=1024
CONFIG_HTTPD_MAX_URI_LEN=512

# Stack sizes
CONFIG_ESP_MAIN_TASK_STACK_SIZE=8192

# Logs
CONFIG_LOG_DEFAULT_LEVEL_INFO=y

# mbedTLS
CONFIG_MBEDTLS_ECP_C=y
CONFIG_MBEDTLS_ECP_DP_SECP256R1_ENABLED=y
CONFIG_MBEDTLS_ECDSA_C=y
CONFIG_MBEDTLS_SHA256_C=y
CONFIG_MBEDTLS_CTR_DRBG_C=y

# WiFi
CONFIG_ESP_WIFI_STATIC_RX_BUFFER_NUM=10
CONFIG_ESP_WIFI_DYNAMIC_RX_BUFFER_NUM=32
```
